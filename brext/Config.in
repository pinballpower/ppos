## brext/Config.in
```kconfig
comment "Pinball Power OS packages"
source "$BR2_EXTERNAL_PPOS_PATH/package/pp-tools/Config.in"
source "$BR2_EXTERNAL_PPOS_PATH/package/pp-updater/Config.in"
source "$BR2_EXTERNAL_PPOS_PATH/package/configtxt/Config.in"
source "$BR2_EXTERNAL_PPOS_PATH/package/pp-systemd/Config.in"
source "$BR2_EXTERNAL_PPOS_PATH/package/pp-dmdreader/Config.in"
source "$BR2_EXTERNAL_PPOS_PATH/package/pp-docker/Config.in"
```

## brext/package/pp-base/Config.in
```kconfig
config BR2_PACKAGE_PP_BASE
	bool "pp-base"
        help
          install base PPOS prerequisites
           - Raspberry Pi firmware
        select BR2_PACKAGE_NTP
	select BR2_PACKAGE_NTP_NTPD
	select BR2_PACKAGE_NTP_NTPDATE
	select BR2_PACKAGE_NTP_NTPTIME
```

## brext/package/pp-dmdreader/Config.in
```kconfig
config BR2_PACKAGE_PP_DMDREADER
        bool "pp-dmdreader"
        help
          "DMDReader reads data from a DMD
	select BR2_PACKAGE_BOOST
 	select BR2_PACKAGE_BOOST_LOG
	select BR2_PACKAGE_BOOST_SYSTEM
	select BR2_PACKAGE_BOOST_IOSTREAMS
	select BR2_PACKAGE_LIBDRM
	select BR2_PACKAGE_SDL2
	select BR2_PACKAGE_SDL2_OPENGLES
```

## brext/package/pp-docker/Config.in
```kconfig
config BR2_PACKAGE_PP_DOCKER
	bool "docker stuff"
        help
          add docker and some configs
	select BR2_PACKAGE_DOCKER_ENGINE
	select BR2_PACKAGE_DOCKER_ENGINE_DAEMON
	select BR2_PACKAGE_DOCKER_COMPOSE
	select BR2_PACKAGE_DOCKER_CONTAINERD
	
```

## brext/package/pp-systemd/Config.in
```kconfig
config BR2_PACKAGE_PP_SYSTEMD
	bool "systemd optimisations"
        help
          optimize some default systemd configurations
	depends on BR2_PACKAGE_SYSTEMD
```

## brext/package/pp-tools/Config.in
```kconfig
config BR2_PACKAGE_PP_TOOLS
	bool "pp-tools"
        help
	  Several helper PPOS helper tools
        depends on BR2_PACKAGE_PP_BASE
	select BR2_PACKAGE_COREUTILS
        select BR2_PACKAGE_PYTHON3
        select BR2_PACKAGE_PYTHON_SPIDEV
        select BR2_SYSTEM_BIN_SH_BASH
        select BR2_PACKAGE_LINUX_TOOLS_PERF
	select BR2_PACKAGE_LINUX_TOOLS_PERF_TUI
	select BR2_PACKAGE_JQ
	select BR2_PACKAGE_RNG_TOOLS
	select BR2_PACKAGE_ZIP
	select BR2_PACKAGE_PROCPS_NG
```

## brext/package/pp-updater/Config.in
```kconfig
config BR2_PACKAGE_PP_UPDATER
	bool "pp-updater"
        help
	  "Update tools for PPOS"
	depends on BR2_PACKAGE_RPI_FIRMWARE
	select BR2_PACKAGE_E2FSPROGS
	select BR2_PACKAGE_E2FSPROGS_RESIZE2FS
	select BR2_PACKAGE_PARTED
        select BR2_PACKAGE_F2FS_TOOLS
```
